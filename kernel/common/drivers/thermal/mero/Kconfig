## kernel/common/drivers/thermal/mero/Kconfig
```kconfig
#
# Thermal zone driver for AMD Mero Subsystem
#
# Copyright (C) 2020 Advanced Micro Devices, Inc. All rights reserved.
#
config MERO_X86_THERMAL
	tristate "Mero x86 component thermal initialization"
	depends on X86 && DRM_AMDGPU
	default m
	help
	  Enable the mero thermal zone x86 cpu component driver.
	  The user interface is exposed by generic thermal
	  framework.

	  Say 'Y' if need to enable the mero x86 thermal zone.

config MERO_SOC_THERMAL
	tristate "Mero SOC component thermal initialization"
	depends on X86 && DRM_AMDGPU
	default m
	help
	  Enable the mero thermal zone SOC component driver.
	  The user interface is exposed by generic thermal
	  framework.

	  Say 'Y' if need to enable the mero x86 thermal zone.

config MERO_CVIP_THERMAL
	tristate "Mero CVIP component thermal initialization"
	depends on X86 && DRM_AMDGPU
	default m
	help
	  Enable the mero thermal zone CVIP component driver.
	  The user interface is exposed by generic thermal
	  framework.

	  Say 'Y' if need to enable the mero x86 thermal zone.

config MERO_GFX_THERMAL
	tristate "Mero GFX component thermal initialization"
	depends on X86 && DRM_AMDGPU
	default m
	help
	  Enable the mero thermal zone GFX component driver.
	  The user interface is exposed by generic thermal
	  framework.

	  Say 'Y' if need to enable the mero x86 thermal zone.

config MERO_THERMAL
	tristate "Mero thermal zone interface support"
	depends on X86 && DRM_AMDGPU
	default m
	help
	  Enable the mero thermal interface for common mero device
	  usage. The thermal trip and value can be override through
	  tz_cfg.

	  Say 'Y' if need to enable mero thermal zone infrastructure.
```

## kernel/common/ml_sec/Kconfig
```kconfig
#
# MagicLeap's Security configuration
#

menu "MagicLeap's Security configuration"

config MLSEC_EXEC_IMPLIES_DENYWRITE
	bool "Deny changes to files that are mmap'd with execute permission"
	help
	   Sets the MAP_DENYWRITE when a file backed mmap is performed with
	   PROT_EXEC.

config MLSEC_DISABLE_READ_IMPLIES_EXEC
    bool "Disable read_implies_exec personality change in the elf parsing phase"
    help
        Disables personality change in specific elfs (complex logic) that triggers
        bugs when elf signing is enabled

config MLSEC_ELF_SIGNING
	bool "Signature verification for all ELF binaries"
	depends on MLSEC_EXEC_IMPLIES_DENYWRITE
	depends on MLSEC_DISABLE_READ_IMPLIES_EXEC
#	depends on PAX_MPROTECT
	select SYSTEM_DATA_VERIFICATION
	select CRYPTO_SHA512
	help
	   Checks that each ELF binary that is loaded as executable is properly
	   signed during their load.

config MLSEC_ELF_SIGNING_DEVELOP
	bool "Enable Signing in development mode"
	depends on MLSEC_ELF_SIGNING
	help
	   In development mode, you can disable the signing using debugfs

config MLSEC_SANDBOX
	bool "Enable Sandbox features"
	help
		Enables the sandbox

config MLSEC_JAIL_DEBUGFS
	bool "Enable Jail's debugfs"
	depends on DEBUG_FS
	help
		Enables the Jail's debugfs (jail_permissive) in /sys/kernel/debug/ml_sec

config MLSEC_SANDBOX_AUDIT
	bool "Enable Sandbox auditing"
	depends on MLSEC_SANDBOX

config MLSEC_SANDBOX_DEVELOP
	bool "Enable Sandbox in development mode"
	depends on MLSEC_SANDBOX
	select MLSEC_SANDBOX_AUDIT
	help
	   Sandbox in development mode enables the use of 'syscalls.profile' and
	   'sandbox.profile' for manual control over the Sandbox operation.

config MLSEC_SANDBOX_KILLABLE
	bool "Enable sandboxed processes killing and signal processing"
	default n
	help
	   Do not set flag SIGNAL_UNKILLABLE for jailed/sandboxed processes.
	   It allows to handle signals and produce core files.

	   If unsure, say N.

config MLSEC_ALLOW_PERMISSIVE_DEBUGGING
	bool "Allow permissive debugging mode"
	depends on DEBUG_FS
#	depends on PAX_MPROTECT
	help
	   Allow disabling all debug restrictions through debugfs

config MLSEC_COMMON
	bool "Common"
	default y if (MLSEC_SANDBOX || MLSEC_ELF_SIGNING)
	help
	   Do not set this directly, this turns on automatically if either of the
	   ML security features are set.

config MLSEC_CHECK_VERITY
	bool "Validate dm-verity enforcement"
	help
	   Verify that dm-verity is applied on ML internal partitions.

config MLSEC_HARDEN_PTRACE
	bool "Allow ptrace() only on debuggable executables"
	depends on MLSEC_ELF_SIGNING
	help
	   With this flag enabled, the ptrace() syscall will fail for any process
	   which is not marked "is_debuggable" through ML's taildata on the main
	   process executable.

config MLSEC_HARDEN_LOAD_SO
	bool "Allow loading a SO according to the executable's and its signatures"
	depends on MLSEC_ELF_SIGNING
	help
	   While loading a shared object:
	   1. ml-internal executable can't load non-ml-internal SO.
	   2. non-ml-internal SO can only get loaded to executable from same dir.

config MLSEC_SANDBOX_VIOLATION_LOGGING
	bool "Signal SIGVIOLATION if action is denied"
	depends on MLSEC_SANDBOX
	help
	   This option will cause the kernel to signal the calling process
	   if the action generates a sandbox violation.

config MLSEC_SELINUX_VIOLATION_LOGGING
	bool "Signal SIGVIOLATION if action is denied"
	depends on SECURITY_SELINUX
	help
	   This option will cause the kernel to signal the calling process
	   if the action generates SELinux violation.

config MLSEC_STACK_ADDRESS_DUMP
	bool "Show addresses in x86 stack trace"
	default n
	help
	   Show kernel addresses additionally to symbol names when dumping stack
	   trace. Kernel addresses is often useful during exploitation of vulnerabilities.
	   The attacker can insert malicious code into the kernel address space by various
	   means and redirect the kernel's execution to that code.

config MLSEC_FSCRYPT_ASCENDING_ENCRYPTION
	bool "Enable fscrypt encryption levels"
	help
	   This option will enable FBE encryption levels.
	   The levels are C0 - Encrypted with device key.
	   C1 - Encrypted with key available during a login session.
	   C2 - Encrypted with key available during a login session
	   and evicted on lockscreen.
	   Once enabled, higher encryption level is allowed over lower levels.

endmenu
```

## leapcore/cvcore/kernel/cvip/Kconfig
```kconfig
config ML_CVIP_ARM
	bool "ML CVIP ARM platform"
	default n
	help
		ML CVIP ARM Platform

config ML_CVIP_X86
	bool "ML CVIP x86 platform"
	default n
	help
		ML CVIP x86 Platform

config ML_MERO_NOTIFIER
    tristate "Magic Leap Interprocessor Notifier"
    default y if ML_CVIP_X86 || ML_CVIP_ARM
    help
        Magic Leap inter-processor notification support in the kernel.  Mero notifier provides
        an API for using the PL-320 to notify another processor and/or process about a given
        named event.

config ML_GSM
	tristate "Magic Leap GSM IP Driver Support"
	default y if ML_CVIP_X86 || ML_CVIP_ARM
	help
		Magic Leap GSM IP functionality support in the kernel.

config ML_MLNET
	tristate "Magic Leap Virtual Network Driver"
	default y if ML_CVIP_X86 || ML_CVIP_ARM
	help
		MLNET is a virtual network driver used for communication between the CVIP and
		the AP. It uses shregion shared memory and mero_notifier to for cross domain
		communication.

config ML_MERO_XPC
	tristate "Magic Leap Cross Processor Communication"
	default y if ML_CVIP_X86 || ML_CVIP_ARM
	help
		Magic Leap cross-processor notification support in the kernel.  Mero XPC provides
		an API for using the PL-320 to notify another processor and/or process via a command,
		notification, or dispatch_queue.

config ML_SHREGION
	tristate "Magic Leap Shared Region"
	default y if ML_CVIP_X86 || ML_CVIP_ARM
	help
		Magic Leap shared regions support in the kernel.  Shared regions is
		an API for allocating regions of shared memory implemented with the
		Ion API.

config ML_CVCORE_TRACE
	tristate "Magic Leap cvcore trace"
	default y if ML_CVIP_ARM
	help
		Magic Leap cvcore trace support in the kernel.

config ML_MERO_SMMU
	tristate "Magic Leap SMMU Driver"
	default y if ML_CVIP_ARM
	help
		SMMU stream id binding/unbinding support in kernel.

config CVIP_PLT
	bool "CVIP platform driver"
	default y if ML_CVIP_ARM
	help
		Enable this configuration option to support the cvip platform driver.
		To compile this driver as a module, choose M here.

config ML_DSP_CORE
	tristate "Magic Leap DSP Core Driver Support"
	default y if ML_CVIP_ARM
	help
		Magic Leap DSP Core support in the kernel.

config ML_CDP
	bool "CVIP Corner Detection Pipeline Engine"
	default y if ML_CVIP_ARM
	depends on ML_SHREGION
	help
		CVIP Corner Detection Pipeline Engine support in the kernel.

config ML_DCPRS
	bool "CVIP Decompression Engine"
	default y if ML_CVIP_ARM
	depends on ML_SHREGION
	help
		CVIP decompression Engine support in the kernel.

config ML_INV_MPU
	bool "Invensense components used by cvip"
	default y if ML_CVIP_ARM
	depends on ML_GSM
```
