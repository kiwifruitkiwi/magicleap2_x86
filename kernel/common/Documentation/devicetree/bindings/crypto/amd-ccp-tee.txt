## kernel/common/Documentation/devicetree/bindings/soc/amd/mero/cvip/amd,dcprs.txt
```
decompression engine for CVIP:
------------------------------------

Required Properties:
- compatible : should contain "amd,dcprs".
- iommus: Should point to the corresponding IOMMU block.
- reg: address and size of dcprs node

Optional Properties:
- interrupts: The interrupt signal from TBU.

Example:
  dcprs@d3800000 {
        compatible = "amd,dcprs";
        reg = <0x0 0xd3800000 0x0 0x800000>;
        iommus = <&smmu 0x40000>;
  };
```

## kernel/common/Documentation/devicetree/bindings/soc/amd/mero/cvip/amd,ipc-core.txt
```
Amd IPC Core for CVIP:

defines mailboxs used for Amd IPC
------------------------------------

Required Properties:
- compatible : should contain "amd,ipc-core".
- mbox-name  : Name of the mailbox.
- mboxes     : Standard property to specify a Mailbox
               (See ./mailbox.txt).

Example:
    mero-ipc {
        compatible = "amd,ipc-core";
        mboxes = <&ipc1 0>, <&ipc1 9>, <&ipc1 10>, <&ipc0 1>, <&ipc4 0>;
        mbox-names = "sync", "asynctx", "asyncrx", "smurx", "isprx";
    };
```

## kernel/common/Documentation/devicetree/bindings/soc/amd/mero/cvip/amd,isp-ipc.txt
```
Amd ISP IPC node for CVIP:

defines mailboxes used for Amd ISP IPC
------------------------------------

Required Properties:
- compatible : should contain "amd,isp-ipc".
- mbox-names : Name of the mailbox.
- mboxes     : Standard property to specify a Mailbox
               (See ./mailbox.txt).

Example:
    isp-ipc {
        compatible = "amd,isp-ipc";
        mboxes = <&ipc4 0>, <&ipc4 1>;
        mbox-names = "cam0_cntl", "cam1_cntl";
    };
```

## kernel/common/Documentation/devicetree/bindings/soc/amd/mero/cvip/amd,mero-recovery-dump.txt
```
Amd Mero-recovery-dump device node:

------------------------------------

Required Properties:
- compatible : should contain "amd,mero-recovery-dump".
- reg : location of saving the reserved memory base address and size.
- region-size : region size that need to alloc

Example:
	recovery_dump {
		compatible = "amd,mero-recovery-dump";
		reg = <0x0 0xaff0 0x0 0x10>;
		region-size = <0x200000>;
	};
```

## kernel/common/Documentation/devicetree/bindings/soc/amd/mero/cvip/amd,mero-smu.txt
```
Amd SMU node for MERO:

------------------------------------

Required Properties:
- compatible : should contain "amd,mero-smu".
- reg	     : Base address and size of the SMU registers

Example:
	apu_smu {
		compatible = "amd,mero-smu";
		reg = <0x1 0x03b10000 0 0x1000>;
	};
```
