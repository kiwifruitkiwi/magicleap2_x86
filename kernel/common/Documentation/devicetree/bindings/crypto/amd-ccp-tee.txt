## kernel/common/Documentation/devicetree/bindings/crypto/amd-ccp-tee.txt
```
* AMD Cryptographic Coprocessor driver (ccp)

Required properties:
- compatible: Must be "amd,cvip-psp"
- reg: Base address and length of the register set
       and memory mapped region for the device

Example:
	sp_platform {
		compatible = "amd,cvip-psp";
		reg = <0x1 0x03810000 0 0x0C00>,
		      <0x0 0xb000 0x0 0x1000>,
		      <0x0 0x800000 0x0 0x1000>;
	};
```

## kernel/common/Documentation/devicetree/bindings/crypto/amd-ccp.txt
```
* AMD Cryptographic Coprocessor driver (ccp)
* Copyright (C) 2020 Advanced Micro Devices, Inc. All rights reserved.

Required properties:
- compatible: Should be "amd,ccp-seattle-v1a"
- reg: Address and length of the register set for the device
- interrupts: Should contain the CCP interrupt

Optional properties:
- dma-coherent: Present if dma operations are coherent

Example:
	ccp@e0100000 {
		compatible = "amd,ccp-seattle-v1a";
		reg = <0 0xe0100000 0 0x10000>;
		interrupt-parent = <&gic>;
		interrupts = <0 3 4>;
	};
```

## kernel/common/Documentation/devicetree/bindings/hwmon/ml,ml_pwr_mon.txt
```
Magic Leap Power Monitor driver

The power monitor driver registers INA devices from the EC
as hwmon devices and receives updates for current, voltage,
and power for the channels.

Required properties:
- compatible: "ml,ml_pwr_mon"

Example:
pwr_mon {
	compatible = "ml,ml_pwr_mon";
	mlmux = <&mux>;
};
```

## kernel/common/Documentation/devicetree/bindings/leds/leds-mlmux.txt
```
ML Mux LED driver

The led_mlmux is a LED driver that sends LED settings
to LED component on EC over mlmux channel. The settings
are programmed into the hardware by the LED driver on
the EC.  When the settings are read from sysfs, the
values are retrieved from LED component on EC.

Required properties:
- compatible: "ml,leds_mlmux"

Example:
mlmux-leds {
	compatible = "ml,leds_mlmux";
	mlmux = <&mux>;
};
```

## kernel/common/Documentation/devicetree/bindings/mailbox/mero-ipc.txt
```
--------------------------------------------------------------------
Amd Mailbox for CVIP:
Copyright (C) 2021 Advanced Micro Devices, Inc. All rights reserved.
--------------------------------------------------------------------

Mero Mailbox Driver
===================

Required Properties:
- compatible:	Should contain "amd,mero-ipc"
- reg:		Base address and size of the mailbox registers.
- #mbox-cells:	Shall be 1 - the index of the channel needed.
		<&phandle channel>
		 phandle : Label name of controller
		 channel : Channel number
- mbox-num:	Number of mailboxs
- interrupts:	Interrupt number. The interrupt specifier format
		depends on the interrupt controller parent.
- parameters:	The parameters of all mailboxs.
		<mbid srcid destid mode ...[mbid srcid destid mode]>
		 mbid: mailbox id
		 srcid: source core index
		 destid: destination core index
		 mode: mode setting format
		 +----------+---------+---------+----------+
		 |    31:30 |   29:25 |      24 |    23:19 |
		 +----------+---------+---------+----------+
		 | Reserved | Number  | Soft    | Reserved |
		 |          | of      | Mailbox |          |
		 |          | Mailbox | Link    |          |
		 +----------+---------+---------+----------+

		 +-------+------+-------+----------+------+------+
		 |    18 | 17   | 16    | 15:2     | 1    | 0    |
		 +-------+------+-------+----------+------+------+
		 | Write | Read | Slave | Reserved | Auto | Auto |
		 | Only  | Only | Mode  |          | Link | ACK  |
		 |       |      |       |          |      |      |
		 +-------+------+-------+----------+------+------+

Optional Properties:
- affinity:	cpu affinity for each interrupt.
- interrupt-names:	interrupt name when request_irq().

Example:
	ipc0: mailbox@da000000 {
		compatible = "amd,mero-ipc";
		reg = <0x0 0xda000000 0x0 0x800000>;
		#mbox-cells = <1>;
		mbox-num = <32>;
		interrupt-parent = <&gic>;
		interrupts = <GIC_SPI 0 IRQ_TYPE_LEVEL_HIGH>,
		...
		interrupt-names = "isp_cam_ctrl", "isp_stats";
		affinity = <0 1 2 3>;
		parameters = <0 1 0 1>
		...
	};
```

## kernel/common/Documentation/devicetree/bindings/mailbox/mero-test.txt
```
Mero Mailbox Test Driver
========================

Required Properties:
- compatible:	Should contain "amd,mero-mbox-test"
- con_phandle:	phandle list of mailbox controller nodes for test.

Example:
	mero_mbox_test {
		compatible = "amd,mero-mbox-test";
		con_phandle = <&ipc0 &ipc1 &ipc2 &ipc3 &ipc4>;
	};
```

## kernel/common/Documentation/devicetree/bindings/misc/amd,cvip-xport.txt
```
--------------------------------------------------------------------
Amd xport device for CVIP:
Copyright (C) 2021 Advanced Micro Devices, Inc. All rights reserved.
--------------------------------------------------------------------

Required Properties:
- compatible : should contain "amd,cvip-xport".

Example:
    xport@0 {
        compatible = "amd,cvip-xport";
    };
```

## kernel/common/Documentation/devicetree/bindings/misc/ml,mlm_ctrl_stm32.txt
```
ML Mux SPI controller driver

The controller side of ML Mux IPC over SPI PHY

Required properties:
- compatible: must be the following
  - "ml,mlm_ctrl_stm32"

Example:
mux: stm32l462_i2c@66 {
	compatible = "ml,mlm_ctrl_stm32";
};
```

## kernel/common/Documentation/devicetree/bindings/misc/ml,mlmux_fcmd.txt
```
ML Mux FCMD character device driver

The mlmux_fcmd is a character device driver that sends
factory test commands to STM over mlmux channel.

Required properties:
- compatible: "ml,mlmux_fcmd"

Example:
mlmux_fcmd_comm {
	compatible = "ml,mlmux_fcmd";
	mlmux = <&mux>;
};
```

## kernel/common/Documentation/devicetree/bindings/misc/ml,test_mlmux.txt
```
ML Mux Test Client driver

The test client of ML Mux IPC

Required properties:
- compatible: "ml,test_mlmux"

Example:
mlmux_test {
	compatible = "ml,test_mlmux";
	mlmux = <&mux>;
};
```

## kernel/common/Documentation/devicetree/bindings/pci/amd,apu-pcie-cfg.txt
```
Amd request translator by IOMMU for CVIP to access x86 managed PCIE device:
------------------------------------

Required Properties:
- compatible : should contain "amd,apu-pcie-cfg".
- reg: Aperture address space start and size.
- interrupts: The interrupt signal from the function block.

Optional Properties:
- iommus: Should point to the corresponding IOMMU block.
- device_type: Should be "pci".
- map_base: Base address of mapped physical memory, defaults to 0x0
- map_size: Length of mapped physical memory, defaults to 0x0
- nbio_user_bits_addr: nbio user bits register address
- nbio_user_bits_szie: nbio user bits register size
- nbio_user_bits_default_value: default value of nbio user bits register

Example:
    pcie@2000000000 {
        compatible = "amd,apu-pcie-cfg";
        reg = <0x20 0x00000000 0x8 0x00000000>;
        interrupt-parent = <&gic>;
        interrupts =
                 //TBU_apu1.ras or TBU_apu1.pmu
                 <GIC_SPI 146 IRQ_TYPE_EDGE_RISING>;
        iommus = <&smmu 1>;
        device_type = "pci";
        map_base = <0xa0000000 0x00000000>;
        map_size = <0x0 0x4000>;
        nbio_user_bits_addr = <0x0 0x80087c>;
        nbio_user_bits_size = <0x4>;
        nbio_user_bits_default_value = <0x5>;
  };
```

## kernel/common/Documentation/devicetree/bindings/pci/mero-cvip-pcie.txt
```
* AMD CVIP PCIe interface

Required properties:
- compatible:
	"pci-host-ecam-amd" for root port;
- reg: Should contain the configuration address space.
- reg-names: Should contain the name of the configuration address space
- #address-cells: Address representation for root ports (must be 3)
- #size-cells: Size representation for root ports (must be 2)
- linux,pci-probe-only: 0: linux allocate pci device resource during enum
                        1: FW allocate pci device resource during enum
- linux,pci-domain:
   If present this property assigns a fixed PCI domain number to a host bridge,
   otherwise an unstable (across boots) unique number will be assigned.
   It is required to either not set this property at all or set it for all
   host bridges in the system, otherwise potentially conflicting domain numbers
   may be assigned to root buses behind different host bridges.  The domain
   number for each host bridge in the system must be unique.
- device_type: set to "pci"
- ranges: ranges for the PCI memory and I/O regions
- bus-range: PCI bus numbers covered (only 0x80-0xff can be
		used in CVIP)
- apu_pcie_m: subnode for setting up smmu table for M interface.
              amd,cvip-biommu.txt can tell more about "amd,cvip-biommu".

Example configuration:

	pcie0: pcie@0x2000000000
		{
			compatible = "pci-host-ecam-amd";
			linux,pci-probe-only = <1>;
			linux,pci-domain = <0x0>;
			#address-cells = <3>;
			#size-cells = <2>;
			device_type = "pci";
			bus-range = <0x80 0xff>;
			reg = <0x22 0x00000000 0 0x20000000>,
			      <0x26 0x20008000 0 0x00008000>,
			      <0x26 0x30000000 0 0x30000000>,
			      <0x0  0x00800000 0 0x00001000>,
			      <0x1  0x1013a320 0 0x00000010>;
			reg-names = "cfg", "io", "mmio", "cvip", "flushctrl";

			ranges =
				/* 64-bit MMIO (size= 30G) */
				<0x03080000 0x20 0x80000000 0X20 0x80000000
				 0x7 0x80000000>;
			apu_pcie_m {
				compatible = "amd,cvip-biommu";
				iommus = <&smmu 0x60000>;
				output_addr = <0x0 0xd9060000>;
				map_size = <0x0 0x00010000>;
				input_addr = <0x0 0x00100000>;
				map_prot = <0x0 0x00000003>;
			};
		};
```

## kernel/common/Documentation/devicetree/bindings/perf/arm-smmuv3-pmu.txt
```
* ARM SMMU V3 PMU Bindings

This is ARM SMMUv3 PMU (Performance Monitoring Unit) module.

Required properties:
- compatible		: Shall be "arm,smmu-v3-pmcg"
- SMMU_ADDR:		: reference to smmuv3 device node
- interrupt-parent	: reference to interrupt parent device node
- interrupts		: interrupt number generated by the control block
- interrupt-names	: Shall be "combined"

Optional properties:
- override_cfg		: override parameter for SMMUV3 PMCG CFGR register
- override_ceid		: override parameters for SMMUV3 PMCG CEID registers

Example:
	smmu_v3_pmcg {
		compatible = "arm,smmu-v3-pmcg";
		SMMU_ADDR = <&smmu>;
		override_cfg = <0x00c01f03>;
		override_ceid = <0x0 0x7f 0x0 0x0>;
		interrupt-parent = <&gic>;
		interrupts = <GIC_SPI 150 IRQ_TYPE_EDGE_RISING>;
		interrupt-names = "combined";
	};
```

## kernel/common/Documentation/devicetree/bindings/pinctrl/amd,cvip-pinctrl.txt
```
MERO CVIP pin controller

Required properties:
- compatible	: "mero,cvip-pinctrl"
- reg		: Address range of the pinctrl registers

For example, pinctrl might have properties like the following:
	cvip_pinctrl {
		compatible = "amd,cvip-pinctrl";
		reg =	<0x1 0x02d01d00 0x0 0x90>, /* IOMUX Registers */
			<0x1 0x02d02980 0x0 0x1f>; /* CVIP IOMUX Registers */

		uart_default: uart_default {
			mux {
				pins = "gpio141", "gpio143", "gpio144";
				function = "uart";
			};
		};
		...
	};
```

## kernel/common/Documentation/devicetree/bindings/rtc/rtc-cvip.txt
```
CVIP Real Time Clock
====================

Required Properties:
 - compatible: Should be "amd,cvip-rtc"
 - reg: Specifies physical base address and size

Example:

rtc@‭102d01700‬ {
	compatible = "amd,cvip-rtc";
	reg = <0x1 0x02d01700‬ 0x0 0x1000>
};
```

## kernel/common/Documentation/devicetree/bindings/serial/amd,hdtout-uart.txt
```
* AMD HDTOUT UART

The AMD's HDTOUT UART is used for interfacing SoC with serial
communication devices in an emulation environment. No flow control
and clock control in this emulation UART.

Required properties:
- compatible: should be "amd,hdtout-1.0"

- reg: base physical address of the controller and length of memory mapped
  region.

Example:
	hdtout_uart0: serial@800000 {
		status = "ok";
		compatible = "amd,hdtout-1.0";
		reg = <0x0 0x800000 0x0 0x1000>;
	};
```

## kernel/common/Documentation/devicetree/bindings/soc/amd/mero/cvip/amd,cvip-biommu.txt
```
Amd Bus IOMMU for CVIP:
------------------------------------

Required Properties:
- compatible : should contain "amd,cvip-biommu".
- iommus: Should point to the corresponding IOMMU block.
- output_addr: Base address of mapped physical memory
- map_size: Length of mapped physical memory
- input_addr: Offset of mapped physical memory
- map_prot: Protect permission of mapped physical memory
            0x1 - Read permission
            0x2 - Write permission

Optional Properties:
- interrupts: The interrupt signal from TBU.
- no-suspend-unmap: bypass iommu unmap during pm suspend

Example:
    smn@2000000000 {
        compatible = "amd,cvip-biommu";
        interrupt-parent = <&gic>;
        interrupts = <GIC_SPI 146 IRQ_TYPE_EDGE_RISING>;
        iommus = <&smmu 1>;
        output_addr = <0xa0000000 0x00000000>;
        map_size = <0x0 0x4000>;
        input_addr = <0x0 0x00000000>;
        map_prot = <0x0 0x00000003>;
  };
```

## kernel/common/Documentation/devicetree/bindings/soc/amd/mero/cvip/amd,cvip-dsp.txt
```
Amd dsp driver for CVIP:
------------------------------------

Required Properties:
- compatible : should contain "amd,cvip-dsp".
- #size-cells : should be 2 indicate "reg" property need 2 cells to describe aperture size.
- #address-cells : should be 2 indicate "reg" property need 2 cells to describe aperure base address.
- interrupts: TBU interrupts from IOMMU.
- range :must be empty.

Optional Properties:
- bypass_pd_control : boolean to indicate the DSP PD power up/down control should be bypassed.

Example:
	q6_0: dsp@c4000000 {
		#size-cells = <0x2>;
		#address-cells = <0x2>;
		ranges;
		compatible = "amd,cvip-dsp";
		interrupt-parent = <&gic>;
		interrupts =
			//TBU_Q6_p0_0.ras or TBU_Q6_p0_0.pmu
			<GIC_SPI 118 IRQ_TYPE_EDGE_RISING>,
			//TBU_Q6_p0_1.ras or TBU_Q6_p0_1.pmu
			<GIC_SPI 119 IRQ_TYPE_EDGE_RISING>;
		interrupt-names = "pn_0", "pn_1";

		icache@1 {
			compatible = "amd,cvip-biommu";
			iommus = <&smmu 0x1>;
			output_addr = <0x0 0xc4000000>;
			map_size = <0x0 0x000c0000>;
			input_addr = <0x0 0xc4000000>;
			map_prot = <0x0 0x00000001>;
		};

		dcache@2 {
			compatible = "amd,cvip-biommu";
			iommus = <&smmu 0x2>;
			output_addr = <0x0 0xdb000000>;
			map_size = <0x0 0x00800000>;
			input_addr = <0x0 0xdb000000>;
			map_prot = <0x0 0x00000003>;
		};

		idma@3 {
			compatible = "amd,cvip-biommu";
			iommus = <&smmu 0x3>;
			output_addr = <0x10 0x00000000>;
			map_size = <0x0 0x00080000>;
			input_addr = <0x0 0xfff80000>;
			map_prot = <0x0 0x00000003>;
		};
	};
```

## kernel/common/Documentation/devicetree/bindings/soc/amd/mero/cvip/amd,cvip-pci-msi.txt
```
Amd MSI controller node for CVIP:

------------------------------------

Required Properties:
- compatible : should contain "amd,cvip-pci-msi".
- msi-controller : this device is a msi controller.

Example:
	msi-cvip {
		compatible = "amd,cvip-pci-msi";
		msi-controller;
	};
```

## kernel/common/Documentation/devicetree/bindings/soc/amd/mero/cvip/amd,cvip-scpi.txt
```
Amd SCPI node for CVIP:

defines scpi firmware protocol used for Amd scpi
------------------------------------

Required Properties:
- compatible : should contain "amd,cvip-scpi".
- reg        : Base address and size of the SMU registers
- clocks     : standard arm scpi clock property
               (See ./arm,scpi.txt).

Example:
	scpi_protocol: scpi@03b10000 {
		compatible = "amd,cvip-scpi";
		reg = <0x0 0x03b10000 0 0x1000>;
		clocks {
			compatible = "arm,scpi-clocks";
			scpi_dvfs: scpi_clocks@0 {
				compatible = "arm,scpi-dvfs-clocks";
				#clock-cells = <1>;
				clock-indices = <0>, <1>;
				clock-output-names = "a55clk", "a55twoclk";
				operating-points-v2 = <&cpu_opp_table>;
			};
			scpi_clk: scpi_clocks@2 {
				compatible = "arm,scpi-variable-clocks";
				#clock-cells = <1>;
				clock-indices = <2>, <3>, <4>;
				clock-output-names = "c5clk", "q6clk", "nicClk";
			};
		};
	};
```
