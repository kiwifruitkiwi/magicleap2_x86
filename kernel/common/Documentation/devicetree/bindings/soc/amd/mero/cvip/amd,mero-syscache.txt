## kernel/common/Documentation/devicetree/bindings/soc/amd/mero/cvip/amd,mero-syscache.txt
```
* AMD CVIP system cache

Required properties:
- compatible: must be "amd,mero-syscache"
- reg: Base address and size of the CVIP control/status registers
       and PL310 controllers registers
- interrupt-parent: Parent of PL310 controller interrupt
- interrupts: Interrupts of DECERR, SLVERR, ERRRD, ERRRT, ERRWD,
              ERRWT, PARRD, PARRT, ECNTR from PL310 controllers

Optional properties:
- arm,tag-latency: Cycles of latency for Tag RAM accesses. Specifies 3 cells of
      read, write and setup latencies. Controllers without setup latency control
      should use 0. Controllers without separate read and write Tag RAM latency
      values should only use the first cell. Should contain 3 entries:
  - setup tag latency
  - read tag latency
  - write tag latency

- arm,data-latency: Cycles of latency for Data RAM accesses. Specifies 3 cells of
      read, write and setup latencies. Minimum valid values are 1. Controllers
      without setup latency control should use a value of 0. Should contain 3 entries:
  - setup data latency
  - read data latency
  - write data latency

- arm,filter-ranges: Starting address and length of window to filter.
      Addresses in the filter window are directed to the M1 port. Other
      addresses will go to the M0 port. Should contain 2 entries:
  - filtering start address
  - filtering range

- arm,event-monitor: When present, enable event monitor bus
- arm,ns-int-ctrl: When present, enable non-secure interrupt access control
- arm,shared-override: When present, shared attribute internally ignored
- arm,parity-enable: When present, enable parity checking
- arm,parity-disable: When present, disable parity checking
- arm,double-linefill: Must be 1 or 0, enable/disable double linefill
- arm,double-linefill-incr: Must be 1 or 0, enable/disable incr double linefill
- arm,double-linefill-wrap: Must be 1 or 0, enable/disable double linefill on WRAP read
- arm,prefetch-drop: Must be 1 or 0, enable/disable prefetch drop
- arm,prefetch-offset: Must be values of 0-7, 15, 23, and 31
- prefetch-data: Must be 1 or 0, enable/disable data prefetching
- prefetch-instr: Must be 1 or 0, enable/disable instruction prefetching
- arm,dynamic-clock-gating: Must be 1 or 0, enable/disable dynamic clock gating
- arm,standby-mode: Must be 1 or 0, enable/disable standby mode
- cache-size: Should not be greater than 512K
- cache-sets: Num of cache sets
- cache-line-size: Size of cache line. If not present, it's equal to blocksize.
- cache-block-size: Size of cache block.

Example configuration:

	SYSCACHE: syscache {
		compatible = "amd,mero-syscache";
		reg = <0x0 0x800000 0x0 0x1000>,
		      <0x1f 0xffffc000 0x0 0x1000>,
		      <0x1f 0xffffd000 0x0 0x1000>,
		      <0x1f 0xffffe000 0x0 0x1000>,
		      <0x1f 0xfffff000 0x0 0x1000>;
		interrupt-parent = <&gic>;
		interrupts = <GIC_SPI 114 IRQ_TYPE_LEVEL_HIGH>,
			     <GIC_SPI 115 IRQ_TYPE_LEVEL_HIGH>,
			     <GIC_SPI 116 IRQ_TYPE_LEVEL_HIGH>,
			     <GIC_SPI 117 IRQ_TYPE_LEVEL_HIGH>;
		arm,tag-latency = <3 3 3>;
		arm,data-latency = <3 3 3>;
		arm,filter-ranges = <0x80000000 0x8000000>;
		arm,event-monitor;
		arm,ns-int-ctrl;
		arm,shared-override;
		arm,parity-enable;
		arm,double-linefill = <1>;
		arm,double-linefill-incr = <1>;
		arm,double-linefill-wrap = <1>;
		arm,prefetch-drop = <1>;
		arm,prefetch-offset = <1>;
		prefetch-data = <1>;
		prefetch-instr = <1>;
		arm,dynamic-clock-gating = <1>;
		arm,standby-mode = <1>;
		cache-size = <0x40000>;
		cache-sets = <512>;
		cache-line-size = <32>;
	};
```

## kernel/common/Documentation/devicetree/bindings/soc/amd/mero/cvip/amd,msi-cvip.txt
```
Amd MSI device node for CVIP:

------------------------------------

Required Properties:
- compatible : should contain "amd,msi-cvip".
- msi-parent : specify parent of msi.

Example:
	msi-cvip {
		compatible = "amd,msi-cvip";
		msi-parent = <&its>;
	};
```

## kernel/common/Documentation/devicetree/bindings/spi/spi-amd.txt
```
AMD SPI controller Device Tree Bindings
-------------------------------------------

Required properties:
- compatible		: Should be "amd,amdi0061-spi"
- reg			: Physical base address and size of SPI registers map.
- interrupts		: Property with a value describing the interrupt
			  number.
- clock-names		: List of input clock names - "spi_clk"
			  (See clock bindings for details).
- clocks		: Clock phandles (see clock bindings for details).


Optional properties:
- amd,read-mode-quirk	: To keep the SPI clock cycle aligned with the data bit
			  number, set the SPI registers(0x40-0x43,0x14,0x15) with
			  the same address value that that device is not used,
			  e.g. 0x39 for the IMU device (icm42600) from InvenSense.

Example:

	spi@102dc8000 {
                compatible = "amd,amdi0061-spi";
                reg = <0x1 0x02dc8000 0 0x1000>;
                spi-controller;
                interrupt-parent = <&gic>;
                interrupts = <GIC_SPI 185 IRQ_TYPE_LEVEL_HIGH>;
                clocks = <&spiclk_100mhz>;
                clock-names = "spi_clk";

                spidev: spidev@0 {
                        status="ok";
                        compatible = "amd,cvip-spi-dev";
                        reg = <0>;
                        spi-max-frequency = <1000000>;
                };
        };
```

## kernel/common/Documentation/devicetree/bindings/staging/ion/mero_ion.txt
```
AMD ION for Mero CVIP

ION is a memory manager that allows for sharing of buffers between different
processes and between user space and kernel space. ION manages different
memory spaces by separating the memory spaces into "heaps".

Required properties:
- compatible: "amd,mero-ion"

Required properties for ION heaps
- reg: the ID of the ION heap.
- memory-region: physical memory region for the heap, can reference to
	memory region nodes defined in reserved-memory section.
- mero,ion-heap-type: the heap type to use for this heap, should be one of
  the following:
	- "SYSTEM"
	- "SYSTEM_CONTIG"
	- "CARVEOUT"
	- "CHUNK"
	- "DMA"

- mero,ion-heap-init-type: option for clearing the memory region to zero when
	heap is created, default is to clear memory to zero, should be one of
	the following:
	- "memory-clear"
	- "memory-no-clear"

Example:
	mero,ion {
		compatible = "amd,mero-ion";
		#address-cells = <1>;
		#size-cells = <0>;

		mero,ion-heap@10 {
			reg = <10>;
			memory-region = <&sram_q6_s0>;
			mero,ion-heap-type = "CARVEOUT";
			mero,ion-heap-init-type = "memory-no-clear";
		};
	};

	reserved-memory {
		#address-cells = <2>;
		#size-cells = <2>;
		ranges;

		sram_q6_s0: q6_s0@c4000000 {
			reg = <0x0 0xc4000000 0x0 0x000c0000>;
		};
	}
```

## kernel/common/Documentation/devicetree/bindings/watchdog/mero-wdt.txt
```
Mero Watchdog Timer

Required Properties:
- compatible : Should contain "amd,mero-wdt".
- reg : Base address and size of the watchdog timer registers.

Optional Properties:
- interrupts : The interrupt used for the watchdog timeout warning.
- frequency : The frequency used for watchdog counter value.
              Default value is 204800.
- timeout : The timeout in seconds used for watchdog counter value.
            Default value is 20.
- withboot : The flag used to start watchdog timer with kernel.
             Default value is 0.
- nowayout : The flag used to config if watchdog can be disabled.
             Default value is 1.
- debug : The debug mode used to print useful values of registers.
- mode : The mode used for watchdog to send reset(0) or interrupt(1)
         signal. Default value is 1.

Example:
	wdt0: watchdog@d2000000 {
		compatible = "amd,mero-wdt";
		reg = <0x0 0x0d2000000 0 0x100>;
		interrupt-parent = <&gic>;
		interrupts = <GIC_SPI 111 IRQ_TYPE_EDGE_RISING>;
		frequency = <128000>;
		withboot = <1>;
		nowayout = <0>;
		timeout = <20>;
		debug = <1>;
		mode = <1>;
	};
```
