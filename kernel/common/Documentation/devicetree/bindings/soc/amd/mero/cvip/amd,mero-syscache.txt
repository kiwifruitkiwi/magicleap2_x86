## kernel/common/drivers/gpu/drm/amd/amdgpu/Kconfig
```kconfig
# SPDX-License-Identifier: MIT
config DRM_AMDGPU_SI
	bool "Enable amdgpu support for SI parts"
	depends on DRM_AMDGPU
	help
	  Choose this option if you want to enable experimental support
	  for SI asics.

	  SI is already supported in radeon. Experimental support for SI
	  in amdgpu will be disabled by default and is still provided by
	  radeon. Use module options to override this:

	  radeon.si_support=0 amdgpu.si_support=1

config DRM_AMDGPU_CIK
	bool "Enable amdgpu support for CIK parts"
	depends on DRM_AMDGPU
	help
	  Choose this option if you want to enable support for CIK asics.

	  CIK is already supported in radeon. If you enable this option,
	  support for CIK will be provided by amdgpu and disabled in
	  radeon by default. Use module options to override this:

	  radeon.cik_support=1 amdgpu.cik_support=0

config DRM_AMDGPU_USERPTR
	bool "Always enable userptr write support"
	depends on DRM_AMDGPU
	depends on MMU
	select MMU_NOTIFIER
	help
	  This option selects CONFIG_MMU_NOTIFIER if it isn't already
	  selected to enabled full userptr support.

config DRM_AMDGPU_GART_DEBUGFS
	bool "Allow GART access through debugfs"
	depends on DRM_AMDGPU
	depends on DEBUG_FS
	default n
	help
	  Selecting this option creates a debugfs file to inspect the mapped
	  pages. Uses more memory for housekeeping, enable only for debugging.

config DRM_AMDGPU_DUMP
	bool "Enable AMDGPU GPU dump upon GPU hang"
	depends on DRM_AMDGPU
	depends on DRM_DUMP
	default y
	help
	  Selecting this option enables support for persisting AMDGPU's
	  different blocks register status upon GPU hang.

config DRM_AMDGPU_GMC_DUMP
	bool "Persist GMC block's status"
	depends on DRM_AMDGPU_DUMP
	default y
	help
	  Selecting this option enables support for persisting
	  AMDGPU's GMC block register status upon GPU hang.

config DRM_AMDGPU_GFX_DUMP
	bool "Persist GFX block's status"
	depends on DRM_AMDGPU_DUMP
	default y
	help
	  Selecting this option enables support for persisting
	  AMDGPU's GFX block register status upon GPU hang.

config DRM_AMDGPU_COMPUTE_DUMP
	bool "Persist COMPUTE block's status"
	depends on DRM_AMDGPU_DUMP
	default y
	help
	  Selecting this option enables support for persisting
	  AMDGPU's COMPUTE block register status upon GPU hang.

config DRM_AMDGPU_SDMA_DUMP
	bool "Persist SDMA block's status"
	depends on DRM_AMDGPU_DUMP
	default y
	help
	  Selecting this option enables support for persisting
	  AMDGPU's SDMA block register status upon GPU hang.

source "drivers/gpu/drm/amd/acp/Kconfig"
source "drivers/gpu/drm/amd/display/Kconfig"
source "drivers/gpu/drm/amd/amdkfd/Kconfig"
```

## kernel/common/drivers/gpu/drm/amd/display/Kconfig
```kconfig
# SPDX-License-Identifier: MIT
menu "Display Engine Configuration"
	depends on DRM && DRM_AMDGPU

config DRM_AMD_DC
	bool "AMD DC - Enable new display engine"
	default y
	select SND_HDA_COMPONENT if SND_HDA_CORE
	select DRM_AMD_DC_DCN if (X86 || PPC64) && !(KCOV_INSTRUMENT_ALL && KCOV_ENABLE_COMPARISONS)
	select DRM_AMD_DC_DCN2_1 if DRM_AMD_DC_DCN
	select DRM_AMD_DC_DCN3_0 if DRM_AMD_DC_DCN
	select DRM_AMD_DC_DCN3_01 if DRM_AMD_DC_DCN
	help
	  Choose this option if you want to use the new display engine
	  support for AMDGPU. This adds required support for Vega and
	  Raven ASICs.

config DRM_AMD_DC_DCN
	def_bool n
	help
	  RV and NV family support for display engine

config DRM_AMD_DC_DCN2_1
	def_bool n
	help
	  Choose this option if you want to have
	  Renoir support for display engine

config DRM_AMD_DC_HDCP
	bool "Enable HDCP support in DC"
	depends on DRM_AMD_DC
	help
	 Choose this option
	 if you want to support
	 HDCP authentication

config DRM_AMD_DC_DCN3_0
	def_bool n
	help
	    Choose this option if you want to have
	    Mero support for display engine

config DRM_AMD_DC_DCN3_01
	def_bool n
	help
	    Choose this option if you want to have
	    Mero support for display engine


config DEBUG_KERNEL_DC
	bool "Enable kgdb break in DC"
	depends on DRM_AMD_DC
	help
	  Choose this option
	  if you want to hit
	  kdgb_break in assert.

config DARK_MODE_OPTIMIZED
	bool "Enable additional dark mode power optimizations"
	default n
	depends on DRM_AMD_DC
	help
	  Choose this option if front-end pipe power optimizations should be
	  enabled when entering/exiting dark mode. If disabled, only DP link
	  power will be optimized.

config DARK_MODE_FORCE_NO_PATTERN_LT
	bool "Force no pattern link training during dark mode exit"
	default y
	depends on DRM_AMD_DC
	help
	  Choose this option if no pattern link training (idle pattern)
	  should be used on receivers that report no-aux link training
	  capability. This is a hack to force no-pattern link training on
	  the Chicago2/Orion device, when it reports no-aux link training
	  caps.

config MERO_ORION_B_DPRX
	bool "Using Analogix Orion Bx as MERO DP receiver"
	default y
	depends on DRM_AMD_DC
	help
	  Choose this option if Analogix Orion Bx is connected as MERO DPRX sink
	  device.

config DRM_AMD_VSYNC_STB_LOGGING
	bool "Enable STB logging of VSync event"
	default n
	depends on DRM_AMD_DC
	help
		Choose this option if you want to have VSync STB logging in Mero.
		Includes addition of various pci device structs in order to
		properly use the STB buffer.
		If disabled, then VSync will not be logged to the STB buffer.

endmenu
```

## kernel/common/drivers/gpu/drm/amd/display/cv_test/Kconfig
```kconfig
config DRM_AMDGPU_CV_STUB
	tristate "Enable CV stub driver"
	depends on DRM && DRM_AMDGPU
	default y
	help
	  Choose this option if you want to enable the CV stub
	  interface driver. This is only used to test the interface
	  to the CV driver provided by the amdgpu display driver.
```

## kernel/common/drivers/input/misc/compass/Kconfig
```kconfig
#
# Kconfig for stand-alone compass input device drivers
#

config ML_AK9912
	tristate "AKM 9912 devices"
	depends on SPI && SYSFS && INPUT
	default n
	help
      This driver supports the AKM 9912 devices.
      Driver uses SPI interface and reports data via
      input subsystem.
      Driver supports all four data rates (10, 20, 50, 100Hz)
```

## kernel/common/drivers/input/misc/ml/Kconfig
```kconfig
#
# Magic Leap drivers configuration
#

config INPUT_ML_TOTEM
	tristate "Magic Leap control support"
	depends on INPUT
	help
	  Say Y to enable Magic Leap Totem/Control (MLT) bus driver.

	  To compile this driver as a module, choose M here: the
	  module will be called mlt.

config INPUT_ML_TOTEM_GRIP
	tristate "Magic Leap Grip control support"
	depends on INPUT_ML_TOTEM && INPUT
	help
	  Say Y to enable Magic Leap Grip control driver.

	  To compile this driver as a module, choose M here: the
	  module will be called grip.

config INPUT_ML_TOTEM_ROSHI
	tristate "Magic Leap Roshi control support"
	depends on INPUT_ML_TOTEM && INPUT
	help
	  Say Y to enable Magic Leap Roshi control driver.

	  To compile this driver as a module, choose M here: the
	  module will be called roshi.
```

## kernel/common/drivers/ipc/Kconfig
```kconfig
menuconfig PL320_IPC
	bool "IPC support with PL320"
	help
	  Mailbox framework using ARM PL320 modules.
	  Same IPC library will be used for both x86 and CVIP.
	  Say Y if platform using PL320 mailbox.
	  If in doubt, say N.

if PL320_IPC

config CVIP_IPC
	bool "cvip ipc support"
	default n
	help
	  This option defines whether CVIP IPC is supported.
	  only one of CVIP_IPC or X86_IPC can be set.
	  Say Y here if you want build cvip ipc.
	  If in doubt, say N.

config X86_IPC
	bool "x86 iPC support"
	default n
	help
	  This option defines whether x86 IPC is supported
	  only one of CVIP_IPC or X86_IPC can be set.
	  Say Y here if you want build x86 ipc.
	  If in doubt, say N.

config ISP_IPC
	bool "ISP ipc support"
	default y
	help
	  This option defines whether ISP IPC is supported
	  depend on the system configuration
	  Say Y here if you want build ISP ipc.
	  If in doubt, say N.

config DSP_IPC
	bool "DSP ipc support"
	default n
	help
	  This option defines whether DSP IPC is supported
	  depend on the system configuration
	  Say Y here if you want build DSP ipc.
	  If in doubt, say N.

config IPC_RINGBUFFER
	bool "IPC ringbuffer support"
	default n
	help
	  This option defines whether ringbuffer implementation is supported
	  It is reserved for future implementation.
	  Say Y here if ringbuffer is supported in IPC implementation.
	  If in doubt, say N.

config IPC_UNIT_TESTS
	bool "IPC unit test support"
	default n
	help
	  This option defines whether IPC unit test is enabled.
	  IPC UNIT test can be triggerd through sys node when enabled.
	  Say Y here if ipc unit test is enabled.
	  If in doubt, say N.

config IPC_VIRTIO
	bool "IPC virtio support"
	default n
	help
	  This option defines whether virtIO is supported.
	  It is reserved for future implementation.
	  Say Y here if virtIO is supported in IPC implementation.
	  If in doubt, say N.

config IPC_XPORT
	bool "IPC xport support"
	default n
	help
	  This option defines whether xport heap setup and removal is supported.
	  Say Y here if xport heap request is supported in IPC implementation.
	  If in doubt, say N.

config ISP_SENSOR_SIM
	bool "ISP simulate sensor"
	default n
	help
	  Enable this option to simulate sensor behaviours in driver.
	  It internally will start a timer to achieve this.
	  Say Y here if sensor simulation is needed.
	  If in doubt, say N.

endif
```

## kernel/common/drivers/misc/ml_drivers/Kconfig
```kconfig
#
# Magic Leap Miscellaneous Drivers
#
menu "Magic Leap Miscellaneous Drivers"

config MLMUX_FCMD
	bool "MLMUX for FCMD"
	depends on ML_MUX
	help
	  This character device uses mlmux to communicate to STM.
	  The FCMD server routes the command to the character device
	  using an ioctrl call. The server will block, waiting for
	  the response.

config ML_VICON_RAVEN
	tristate "Motion capture for Vicon on Raven"
	depends on X86 && ML_HYDRA
	help
	  This driver triggers an interrupt on every rising/falling
	  edge and records the current timestamp in a queue

config ML_VICON_MERO
	tristate "Motion capture for Vicon on Mero"
	help
	  This driver triggers an interrupt on every rising/falling
	  edge and records the current timestamp in a queue. This
	  driver is used in conjunction with the Vicon and Optitrack
	  motion capture systems. The motion capture systems output
	  a UART data stream via single GPIO, and this driver
	  timestamps edge changes on the data stream.

config ML_AUDIO_LATENCY_MERO
	bool "Audio latency test for MERO"
	help
	  This driver exposes a gpio that'll be use for audio
	  latency tests.

endmenu
```

## kernel/common/drivers/net/wireless/qcom/Kconfig
```kconfig
# SPDX-License-Identifier: GPL-2.0-only
config WLAN_VENDOR_QUALCOMM
	bool "Qualcomm devices"
	default y
	---help---
	  If you have a wireless card belonging to this class, say Y.

	  Note that the answer to this question doesn't directly affect the
	  kernel: saying N will just cause the configurator to skip all the
	  questions about these cards. If you say Y, you will be asked for
	  your specific card in the following questions.

if WLAN_VENDOR_QUALCOMM

config CLD_LL_CORE
	tristate "QTI core WLAN driver for QCA chipset"
	select NL80211_TESTMODE
	select WEXT_CORE
	select WEXT_PRIV
	select WEXT_SPY
	select WIRELESS_EXT
	help
	  This section contains the necessary modules needed to enable the
	  core WLAN driver for QTI QCA chipset.
	  Select Y to compile the driver in order to have WLAN functionality
	  support.

source "drivers/net/wireless/qcom/cnss2/Kconfig"
source "drivers/net/wireless/qcom/wlan-host/qcacld-3.0/Kconfig"

endif # WLAN_VENDOR_QUALCOMM
```

## kernel/common/drivers/soc/amd/Kconfig
```kconfig
#/*
# * Copyright (C) 2019 Advanced Micro Devices, Inc. All rights reserved.
# */

menu "AMD SoC"

source "drivers/soc/amd/mero/Kconfig"

endmenu
```

## kernel/common/drivers/soc/amd/mero/Kconfig
```kconfig
#/*
# * Copyright (C) 2019 Advanced Micro Devices, Inc. All rights reserved.
# */

menu "Mero SoC"

endmenu
```

## kernel/common/drivers/staging/android/ion/Kconfig
```kconfig
# SPDX-License-Identifier: GPL-2.0
menuconfig ION
	bool "Ion Memory Manager"
	depends on HAS_DMA && MMU
	select GENERIC_ALLOCATOR
	select DMA_SHARED_BUFFER
	help
	  Choose this option to enable the ION Memory Manager,
	  used by Android to efficiently allocate buffers
	  from userspace that can be shared between drivers.
	  If you're not using Android its probably safe to
	  say N here.

config ION_SYSTEM_HEAP
	bool "Ion system heap"
	depends on ION
	help
	  Choose this option to enable the Ion system heap. The system heap
	  is backed by pages from the buddy allocator. If in doubt, say Y.

config ION_CARVEOUT_HEAP
	bool "Ion carveout heap support"
	depends on ION
	help
	  Choose this option to enable carveout heaps with Ion. Carveout heaps
	  are backed by memory reserved from the system. Allocation times are
	  typically faster at the cost of memory not being used. Unless you
	  know your system has these regions, you should say N here.

config ION_CHUNK_HEAP
	bool "Ion chunk heap support"
	depends on ION
	help
	  Choose this option to enable chunk heaps with Ion. This heap is
	  similar in function the carveout heap but memory is broken down
	  into smaller chunk sizes, typically corresponding to a TLB size.
	  Unless you know your system has these regions, you should say N here.

config ION_CMA_HEAP
	bool "Ion CMA heap support"
	depends on ION && DMA_CMA
	help
	  Choose this option to enable CMA heaps with Ion. This heap is backed
	  by the Contiguous Memory Allocator (CMA). If your system has these
	  regions, you should say Y here.

config ION_MERO
	bool "Ion MERO CVIP heap support"
	depends on ION
	help
	  Choose this option if you wish to use ion on an MERO CVIP target.
	  Features include allocating heaps from device tree, buffer
	  cache maintenance, and a custom ioctl/compat_ioctl. Enable
	  utility functions used by ion_system_heap.

config ION_CARVEOUT_HEAP_PAGE_ZERO
	bool "Ion carveout heap to zero page upon creation"
	depends on ION && ION_CARVEOUT_HEAP
	help
	  Choose this option to enable carveout heap regions to be initialized
	  with zero upon creation. On target such as MERO CVIP A55, when
	  carveout heaps for DSP internal SRAM are created at boot time, page
	  zeroing can cause A55 hang due to SRAM is not accessible at early
	  stage, in which case should say N. Unless you know your system has
	  these regions accessible at creation time, you should say N here.

config ION_TEST
	tristate "Ion Test Device"
	depends on ION
	help
	  Choose this option to create a device that can be used to test the
	  kernel and device side ION functions.
```

## kernel/common/drivers/tee/amdtee/Kconfig
```kconfig
# SPDX-License-Identifier: MIT
# AMD-TEE Trusted Execution Environment Configuration
config AMDTEE
	tristate "AMD-TEE"
	default y
	depends on CRYPTO_DEV_CCP_DD && CRYPTO_DEV_SP_PSP
	help
	  This implements AMD's Trusted Execution Environment (TEE) driver.

if AMDTEE

menu "AMDTEE client driver"

source "drivers/tee/amdtee/amdtee_aes/Kconfig"

endmenu

endif
```

## kernel/common/drivers/tee/amdtee/amdtee_aes/Kconfig
```kconfig
# SPDX-License-Identifier: MIT
# AMDTEE CCP AES crypto provider
config AMDTEE_CCP_AES
	tristate "AMD-TEE-CCP-AES"
	default y
	depends on CRYPTO_DEV_SP_PSP || TEE || AMDTEE
	help
	  This implements AMD CCP AES driver.
```
