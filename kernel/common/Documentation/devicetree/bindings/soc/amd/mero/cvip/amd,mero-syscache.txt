## kernel/common/arch/arm64/configs/mero_cvip_mauna_gcov_defconfig
```kconfig
#
# Copyright (C) 2020-2021 Advanced Micro Devices, Inc. All rights reserved.
#
CONFIG_LOCALVERSION="-R57"
CONFIG_NO_HZ_IDLE=y
CONFIG_HIGH_RES_TIMERS=y
CONFIG_IRQ_TIME_ACCOUNTING=y
CONFIG_BSD_PROCESS_ACCT=y
CONFIG_BSD_PROCESS_ACCT_V3=y
CONFIG_TASKSTATS=y
CONFIG_TASK_DELAY_ACCT=y
CONFIG_TASK_XACCT=y
CONFIG_TASK_IO_ACCOUNTING=y
CONFIG_IKCONFIG=y
CONFIG_IKCONFIG_PROC=y

CONFIG_MEMCG=y
CONFIG_MEMCG_SWAP=y
CONFIG_BLK_CGROUP=y
CONFIG_CGROUP_PIDS=y
CONFIG_CGROUP_HUGETLB=y
CONFIG_CPUSETS=y
CONFIG_CGROUP_DEVICE=y
CONFIG_CGROUP_CPUACCT=y
CONFIG_CGROUP_PERF=y
CONFIG_USER_NS=y
CONFIG_SCHED_AUTOGROUP=y
CONFIG_BLK_DEV_INITRD=y
CONFIG_BLK_DEV_LOOP=y
CONFIG_KALLSYMS_ALL=y

# CONFIG_COMPAT_BRK is not set

CONFIG_JUMP_LABEL=y
CONFIG_MODULES=y
CONFIG_MODULE_UNLOAD=y
CONFIG_PCI=y
CONFIG_HOTPLUG_PCI_PCIE=y
CONFIG_HOTPLUG_PCI=y
CONFIG_PCIEPORTBUS=y

CONFIG_ARM64_VA_BITS_48=y
CONFIG_SCHED_MC=y
CONFIG_NR_CPUS=8
CONFIG_PREEMPT=y
# CONFIG_BALLOON_COMPACTION is not set
CONFIG_KSM=y
CONFIG_MEMORY_FAILURE=y
CONFIG_CMA=y
CONFIG_CMA_AREAS=2
CONFIG_SECCOMP=y
CONFIG_CRASH_DUMP=y

# CONFIG_ARM64_SVE is not set
# CONFIG_CORE_DUMP_DEFAULT_ELF_HEADERS is not set
CONFIG_COMPAT=y

CONFIG_WQ_POWER_EFFICIENT_DEFAULT=y
CONFIG_CPU_IDLE=y
CONFIG_ARM_PSCI_CPUIDLE=y
CONFIG_CPU_FREQ=y
CONFIG_CPU_FREQ_STAT=y
CONFIG_CPU_FREQ_GOV_POWERSAVE=m
CONFIG_CPU_FREQ_GOV_USERSPACE=y
CONFIG_CPU_FREQ_GOV_ONDEMAND=y
CONFIG_CPU_FREQ_GOV_CONSERVATIVE=m
CONFIG_CPU_FREQ_GOV_SCHEDUTIL=y
#CONFIG_CPU_FREQ_DEFAULT_GOV_SCHEDUTIL=y
CONFIG_CPUFREQ_DT=y
CONFIG_ARM_BIG_LITTLE_CPUFREQ=y
CONFIG_ARM_SCPI_CPUFREQ=y
CONFIG_MERO_SCPI_PROTOCOL=y
CONFIG_ARM_SCPI_PROTOCOL=y
CONFIG_COMMON_CLK_SCPI=y

CONFIG_NET=y
CONFIG_PACKET=y
CONFIG_UNIX=y
CONFIG_INET=y
CONFIG_IP_MULTICAST=y
CONFIG_IP_PNP=y
CONFIG_IP_PNP_DHCP=y
CONFIG_IP_PNP_BOOTP=y

CONFIG_NETFILTER=y
CONFIG_NF_CONNTRACK=m
CONFIG_NF_CONNTRACK_EVENTS=y
CONFIG_NETFILTER_XT_TARGET_CHECKSUM=m
CONFIG_NETFILTER_XT_TARGET_LOG=m
CONFIG_NETFILTER_XT_MATCH_ADDRTYPE=m
CONFIG_NETFILTER_XT_MATCH_CONNTRACK=m
CONFIG_NF_CONNTRACK_IPV4=m
CONFIG_IP_NF_IPTABLES=m
CONFIG_IP_NF_FILTER=m
CONFIG_IP_NF_TARGET_REJECT=m
CONFIG_IP_NF_NAT=m
CONFIG_IP_NF_TARGET_MASQUERADE=m
CONFIG_IP_NF_MANGLE=m
CONFIG_NF_CONNTRACK_IPV6=m
CONFIG_IP6_NF_IPTABLES=m
CONFIG_IP6_NF_FILTER=m
CONFIG_IP6_NF_TARGET_REJECT=m
CONFIG_IP6_NF_MANGLE=m
CONFIG_IP6_NF_NAT=m
CONFIG_IP6_NF_TARGET_MASQUERADE=m
CONFIG_BRIDGE=m
CONFIG_BRIDGE_VLAN_FILTERING=y

CONFIG_VLAN_8021Q=m
CONFIG_VLAN_8021Q_GVRP=y
CONFIG_VLAN_8021Q_MVRP=y
CONFIG_RFKILL=m
CONFIG_NET_9P=y
CONFIG_NET_9P_VIRTIO=y
CONFIG_UEVENT_HELPER_PATH="/sbin/hotplug"
CONFIG_DEVTMPFS=y
CONFIG_DEVTMPFS_MOUNT=y
CONFIG_DMA_CMA=y
## CONFIG_BRCMSTB_GISB_ARB=y
## CONFIG_VEXPRESS_CONFIG=y

## CONFIG_OF_OVERLAY=y

CONFIG_VIRTIO_BLK=y
# CONFIG_VEXPRESS_SYSCFG is not set

CONFIG_NETDEVICES=y
CONFIG_MACVLAN=m
CONFIG_MACVTAP=m
CONFIG_TUN=y
CONFIG_VETH=m
CONFIG_VIRTIO_NET=y

## CONFIG_MVMDIO=y

## CONFIG_MDIO_BITBANG=y

CONFIG_MDIO_BUS_MUX_MMIOREG=y
CONFIG_USB_PEGASUS=m
CONFIG_USB_RTL8150=m
CONFIG_USB_RTL8152=m
CONFIG_USB_USBNET=m
CONFIG_USB_NET_DM9601=m
CONFIG_USB_NET_SR9800=m
CONFIG_USB_NET_SMSC75XX=m
CONFIG_USB_NET_SMSC95XX=m
CONFIG_USB_NET_PLUSB=m
CONFIG_USB_NET_MCS7830=m
CONFIG_INPUT_POLLDEV=y
CONFIG_INPUT_EVDEV=y
CONFIG_KEYBOARD_GPIO=y
CONFIG_INPUT_MISC=y

# CONFIG_SERIO_SERPORT is not set
CONFIG_LEGACY_PTY_COUNT=16
CONFIG_SERIAL_8250=y
CONFIG_SERIAL_8250_CONSOLE=y
CONFIG_SERIAL_8250_EXTENDED=y
CONFIG_SERIAL_8250_SHARE_IRQ=y
CONFIG_SERIAL_8250_DW=y
CONFIG_SERIAL_OF_PLATFORM=y
CONFIG_SERIAL_DEV_BUS=y
CONFIG_VIRTIO_CONSOLE=y

#
# I2C support
#
CONFIG_I2C=y
CONFIG_I2C_BOARDINFO=y
CONFIG_I2C_COMPAT=y
CONFIG_I2C_CHARDEV=y
CONFIG_I2C_HELPER_AUTO=y
CONFIG_I2C_DESIGNWARE_PLATFORM=y

CONFIG_PINCTRL=y
CONFIG_PINCTRL_SINGLE=y
## CONFIG_GPIOLIB=y
CONFIG_THERMAL=y
CONFIG_THERMAL_GOV_POWER_ALLOCATOR=y
CONFIG_CPU_THERMAL=y
CONFIG_THERMAL_EMULATION=y

CONFIG_SCSI=y

CONFIG_USB=y
CONFIG_USB_OTG=y
CONFIG_USB_STORAGE=y
CONFIG_USB_DWC3=y
CONFIG_USB_DWC3_ULPI=y
#CONFIG_USB_DWC3_GADGET=y
CONFIG_USB_DWC3_DUAL_ROLE=y
CONFIG_USB_DWC3_PCI=y
CONFIG_USB_SERIAL=y
CONFIG_NOP_USB_XCEIV=y
CONFIG_USB_ULPI=y
CONFIG_USB_GADGET=y
CONFIG_USB_MASS_STORAGE=m
CONFIG_USB_SNP_UDC_PLAT=y
CONFIG_USB_ULPI_BUS=y
CONFIG_USB_NET_DRIVERS=y
CONFIG_USB_U_ETHER=m
CONFIG_USB_F_ECM=m
CONFIG_USB_F_SUBSET=m
CONFIG_USB_F_RNDIS=m
CONFIG_USB_ETH=m
CONFIG_USB_ETH_RNDIS=y
CONFIG_USB_ROLE_SWITCH=y

CONFIG_RTC_CLASS=y
CONFIG_RTC_DRV_CVIP=y

CONFIG_DMADEVICES=y
## CONFIG_BCM_SBA_RAID=y
CONFIG_PL330_DMA=y
CONFIG_DMATEST=y
## CONFIG_SYNC_FILE=y
CONFIG_VFIO=y
CONFIG_VFIO_PCI=y
CONFIG_VIRTIO_PCI=y
CONFIG_VIRTIO_BALLOON=y
CONFIG_VIRTIO_MMIO=y
CONFIG_COMMON_CLK_VERSATILE=y
# CONFIG_COMMON_CLK_XGENE is not set
# CONFIG_FSL_ERRATUM_A008585 is not set
# CONFIG_HISILICON_ERRATUM_161010101 is not set
# CONFIG_ARM64_ERRATUM_858921 is not set
CONFIG_MAILBOX=y
CONFIG_PL320_IPC=y
CONFIG_CVIP_IPC=y
CONFIG_MERO_MBOX=y
CONFIG_MERO_MBOX_DEV=y
CONFIG_IPC_XPORT=y
CONFIG_ISP_SENSOR_SIM=y
# CONFIG_ARM_MHU is not set
# CONFIG_PLATFORM_MHU is not set
# Kernel Performance Events And Counters
CONFIG_PERF_EVENTS=y
# end of Kernel Performance Events And Counters
CONFIG_PROFILING=y
CONFIG_HW_PERF_EVENTS=y
CONFIG_HAVE_HW_BREAKPOINT=y
CONFIG_MODULES_TREE_LOOKUP=y
# Performance monitor support
CONFIG_ARM_PMU=y
# end of Performance monitor support
CONFIG_ARM_SMMU_V3=y
CONFIG_ARM_SMMU_V3_PMU=y
CONFIG_EXTCON_USB_GPIO=y
CONFIG_MEMORY=y

CONFIG_TEE=y
CONFIG_OPTEE=y
CONFIG_AMDTEE=y

CONFIG_CRYPTO_DEV_CCP=y
CONFIG_CRYPTO_DEV_CCP_DD=y

# CONFIG_DMIID is not set
CONFIG_EFI_CAPSULE_LOADER=y
CONFIG_EXT2_FS=y
CONFIG_EXT3_FS=y
CONFIG_EXT4_FS_POSIX_ACL=y
CONFIG_FANOTIFY=y
CONFIG_FANOTIFY_ACCESS_PERMISSIONS=y
CONFIG_QUOTA=y
CONFIG_AUTOFS4_FS=y
CONFIG_FUSE_FS=m
CONFIG_CUSE=m
CONFIG_OVERLAY_FS=m
CONFIG_VFAT_FS=y
CONFIG_TMPFS=y
CONFIG_HUGETLBFS=y
CONFIG_CONFIGFS_FS=y
CONFIG_SQUASHFS=y
## CONFIG_PSTORE=y
CONFIG_NFS_FS=y
CONFIG_NFS_V4=y
CONFIG_NFS_V4_1=y
CONFIG_NFS_V4_2=y
CONFIG_ROOT_NFS=y
CONFIG_9P_FS=y
CONFIG_NLS_CODEPAGE_437=y
CONFIG_NLS_ISO8859_1=y

CONFIG_PRINTK_TIME=y
CONFIG_DYNAMIC_DEBUG=y

CONFIG_DEBUG_INFO=y
CONFIG_DEBUG_FS=y
CONFIG_MAGIC_SYSRQ=y
CONFIG_DEBUG_KERNEL=y
CONFIG_GCOV_KERNEL=y
CONFIG_ARCH_HAS_GCOV_PROFILE_ALL=y
CONFIG_GCOV_PROFILE_ALL=y
CONFIG_GCOV_FORMAT_AUTODETECT=y

# CONFIG_SCHED_DEBUG is not set
# CONFIG_DEBUG_PREEMPT is not set
# CONFIG_RUNTIME_TESTING_MENU is not set
# CONFIG_STRICT_DEVMEM is not set
CONFIG_SECURITY=y
##CONFIG_CRYPTO_RSA=y
## CONFIG_CRYPTO_ECDH=y
# CONFIG_CRYPTO_MANAGER_DISABLE_TESTS is not set
## CONFIG_CRYPTO_CCM=y
## CONFIG_CRYPTO_GCM=y
# CONFIG_CRYPTO_ECHAINIV is not set
## CONFIG_CRYPTO_ECB=y
## CONFIG_CRYPTO_CMAC=y
## CONFIG_CRYPTO_SHA512=y
## CONFIG_CRYPTO_ARC4=y
## CONFIG_CRYPTO_DES=y
CONFIG_CRYPTO_HW=y
## CONFIG_ASYMMETRIC_KEY_TYPE=y
## CONFIG_ASYMMETRIC_PUBLIC_KEY_SUBTYPE=y
## CONFIG_X509_CERTIFICATE_PARSER=y
## CONFIG_PKCS7_MESSAGE_PARSER=y
## CONFIG_SYSTEM_TRUSTED_KEYRING=y
CONFIG_ARM64_CRYPTO=y

CONFIG_CRYPTO_SHA1_ARM64_CE=y
CONFIG_CRYPTO_SHA2_ARM64_CE=y
CONFIG_CRYPTO_GHASH_ARM64_CE=y
CONFIG_CRYPTO_CRCT10DIF_ARM64_CE=m
CONFIG_CRYPTO_CRC32_ARM64_CE=m
CONFIG_CRYPTO_AES_ARM64_CE_CCM=y
CONFIG_CRYPTO_AES_ARM64_CE_BLK=y
CONFIG_CRYPTO_CHACHA20_NEON=m
CONFIG_CRYPTO_AES_ARM64_BS=m
CONFIG_CRYPTO_SHA512_ARM64_CE=m
CONFIG_CRYPTO_SHA3_ARM64=m
CONFIG_CRYPTO_SM3_ARM64_CE=m

CONFIG_ARCH_MERO_CVIP=y
CONFIG_GDB_SCRIPTS=y

CONFIG_KEXEC=y

CONFIG_HZ_8000=y
CONFIG_HZ=8000
CONFIG_EFI=n

CONFIG_WATCHDOG=y
CONFIG_MERO_WATCHDOG=y
CONFIG_WATCHDOG_HANDLE_BOOT_ENABLED=y
CONFIG_WATCHDOG_OPEN_TIMEOUT=0

CONFIG_MERO_DSP_MANAGER=y

CONFIG_ANDROID=y
CONFIG_STAGING=y
CONFIG_ION=y
CONFIG_ION_SYSTEM_HEAP=y
CONFIG_ION_CARVEOUT_HEAP=y
CONFIG_ION_CHUNK_HEAP=y
CONFIG_ION_MERO=y
CONFIG_ION_CARVEOUT_HEAP_PAGE_ZERO=n
CONFIG_ION_TEST=y

CONFIG_ANDROID_BINDER_IPC=y
CONFIG_ANDROID_BINDER_DEVICES="binder,hwbinder,vndbinder"
CONFIG_ANDROID_BINDER_IPC_SELFTEST=y

CONFIG_AUDIT=y
CONFIG_AUDITSYSCALL=y
CONFIG_NETWORK_SECMARK=y
CONFIG_SECURITY_NETWORK=y
CONFIG_LSM_MMAP_MIN_ADDR=32768
CONFIG_SECURITY_SELINUX=y
CONFIG_SECURITY_SELINUX_DEVELOP=y
CONFIG_SECURITY_SELINUX_AVC_STATS=y
CONFIG_SECURITY_SELINUX_CHECKREQPROT_VALUE=0
CONFIG_INTEGRITY_AUDIT=y
CONFIG_AUDIT_GENERIC=y
CONFIG_AUDIT_COMPAT_GENERIC=y

CONFIG_SYSVIPC=y
CONFIG_POSIX_MQUEUE=y

CONFIG_CONNECTOR=y

CONFIG_CVIP_SYS_CACHE=y

CONFIG_PCI_CVIP=y
CONFIG_AMD_CVIP_MSI=y

CONFIG_CVIP_LOGGER=y

#
# NVME Support
#
CONFIG_NVME_CORE=y
CONFIG_BLK_DEV_NVME=y
CONFIG_NVME_MULTIPATH=y
CONFIG_NVME_FABRICS=y
CONFIG_NVME_FC=y
CONFIG_NVME_TARGET=y
CONFIG_NVME_TARGET_LOOP=y
CONFIG_NVME_TARGET_FC=y
CONFIG_NVME_TARGET_FCLOOP=y

CONFIG_PM_DEBUG=y
CONFIG_PM_WAKELOCKS=y

#
# MERO SMU Support
#
CONFIG_MERO_SMU=y

#
# Hardware Monitor sensors
#
CONFIG_HWMON=y
CONFIG_SENSORS_MERO=y

CONFIG_FUNCTION_TRACER=y
CONFIG_FUNCTION_GRAPH_TRACER=y
CONFIG_STACK_TRACER=y
CONFIG_DYNAMIC_FTRACE=y

# SPI support
CONFIG_SPI=y
CONFIG_SPI_AMD=y
CONFIG_SPI_SPIDEV=y

CONFIG_RECOVERY_DUMP=y

CONFIG_PINMUX=y
CONFIG_PINCONF=y
CONFIG_PINCTRL_CVIP=y
CONFIG_E1000E=y
CONFIG_NO_ARCHTIMER_SYSTEM_RESTART=y

# GPIO LIB support
CONFIG_GPIOLIB=y
CONFIG_OF_GPIO=y
CONFIG_GPIO_SYSFS=y
CONFIG_GPIO_GENERIC_PLATFORM=y

CONFIG_XPORT_TEST=y

CONFIG_PTP_1588_CLOCK=n
CONFIG_PPS=n
CONFIG_INPUT_MOUSE=n
CONFIG_INPUT_MOUSEDEV=n
CONFIG_INPUT_KEYBOARD=n
CONFIG_HID_APPLE=n
CONFIG_HID_A4TECH=n
CONFIG_HID_BELKIN=n
CONFIG_HID_CHERRY=n
CONFIG_HID_CYPRESS=n
CONFIG_HID_EZKEY=n
CONFIG_HID_KENSINGTON=n
CONFIG_HID_ITE=n
CONFIG_HID_LOGITECH=n
CONFIG_HID_MICROSOFT=n
CONFIG_HID_MONTEREY=n
CONFIG_HID_REDRAGON=n
CONFIG_SERIAL_8250_EXAR=n
CONFIG_SERIAL_8250_PCI=n
```

## kernel/common/arch/x86/configs/ml/acamas_defconfig
```kconfig
CONFIG_USB_NET2280=y
CONFIG_USB_SERIAL=y
CONFIG_USB_SERIAL_FTDI_SIO=y
CONFIG_NVMEM=y
CONFIG_I2C_MCP2221=y
CONFIG_SPI_FT4222=y
CONFIG_I2C_AMD_MP2=y
CONFIG_GPIO_PCA953X=y
CONFIG_GPIO_PCA953X_IRQ=y
CONFIG_ML_AK9912=y
CONFIG_ML_ICM_20602=y
CONFIG_PHYLIB=y
CONFIG_EFI_BOOTLOADER_CONTROL=y
CONFIG_NET_VENDOR_INTEL=y
CONFIG_E100=y
CONFIG_E1000=y
CONFIG_E1000E=y
CONFIG_IIO=y
CONFIG_ICP101XX=m
CONFIG_SYSVIPC=y
CONFIG_POSIX_MQUEUE=y
CONFIG_DRM_VIRTIO_GPU=y
CONFIG_ATH_COMMON=m
CONFIG_ATH10K=m
CONFIG_ATH10K_PCI=m
# CONFIG_DRM_VIRTIO_GPU is not set
CONFIG_I40E=m
CONFIG_I40E_DCB=y
CONFIG_I40EVF=m
CONFIG_ION=y
CONFIG_ION_SYSTEM_HEAP=y
CONFIG_ION_CARVEOUT_HEAP=y
CONFIG_ION_CHUNK_HEAP=y
CONFIG_ION_CMA_HEAP=y
CONFIG_PL320_IPC=y
CONFIG_X86_IPC=y
# Broadcomm Support
CONFIG_BCMDHD=y
CONFIG_BCMDHD_PCIE=y
CONFIG_BCM4375=y
CONFIG_WLAN_VENDOR_BROADCOM=y
CONFIG_BCMDHD_FW_PATH="/system/etc/firmware/wifi/fw_bcmdhd.bin"
CONFIG_BCMDHD_NVRAM_PATH="/system/etc/firmware/wifi/bcmdhd.cal"
CONFIG_BCMDHD_CLM_PATH="/system/etc/firmware/wifi/bcmdhd_clm.blob"
CONFIG_BT_BCM43XX=y
```

## kernel/common/arch/x86/configs/ml/demophon_defconfig
```kconfig
CONFIG_TYPEC=y
CONFIG_TYPEC_UCSI=y
CONFIG_TYPEC_DP_ALTMODE=y
CONFIG_UCSI_MLMUX_USBPD=y
CONFIG_USB_ROLE_SWITCH=y
CONFIG_FAN_MLMUX=y
CONFIG_SPI_AMD=y
CONFIG_ML_VICON_MERO=m
CONFIG_QCA_CLD_WLAN_PROFILE="ml_demophon"
CONFIG_SND_SOC_AMD_ACP5x_CUSTOM_FW="ml_acp5x_"
CONFIG_NLS=y
CONFIG_NLS_UTF8=y
CONFIG_FAT_DEFAULT_CODEPAGE=437
CONFIG_FAT_DEFAULT_IOCHARSET="iso8859-1"
CONFIG_ICP20100=y
CONFIG_ICP20100_I2C=y
CONFIG_CVIP=y
CONFIG_ML_CVIP_X86=y
CONFIG_ACPI_BUTTON=n
CONFIG_ML2_EC_CTRL=y
CONFIG_ML_TSF=y
CONFIG_MLMUX_LOGGER_COMP=y
CONFIG_MLMUX_LWEAR_COMP=y

# Performance tracing
CONFIG_FTRACE=y

CONFIG_EXFAT_FS=y
```

## kernel/common/drivers/base/syscache/Kconfig
```kconfig
config OUTER_CACHE
	bool "outer cache support"
	help
	  This option enables outer_cache.
	  The outer cache has functions that can be used to clean and
	  invalidate outer cache lines, which need address of the callback
	  object.

config OUTER_CACHE_SYNC
	bool "outer cache sync support"
	help
	  The outer cache has a outer_cache_fns.sync function pointer
	  that can be used to drain the write buffer of the outer cache.
	  This option enables support for outer cache sync, which needs
	  address of the callback object.

config CACHE_L2X0
	bool "Enable the L2x0 outer cache controller"
	select OUTER_CACHE
	select OUTER_CACHE_SYNC
	help
	  This option enables the L2x0 PrimeCell.
	  This option should be selected by machines which have a L2x0
	  or PL310 cache controller, but where its use that enables the L2x0
	  outer cache controller is optional.

config CACHE_L2X0_PMU
	bool "L2x0 performance monitor support" if CACHE_L2X0
	select PERF_EVENTS
	help
	  This option enables support for the performance monitoring features
	  of the L220 and PL310 outer cache controllers.

config CVIP_SYS_CACHE
	bool "Enable the system cache controller for CVIP"
	help
	  This option enables the system cache controller for CVIP.
	  This option should be selected by machines which have a system
	  cache controller and controlling interfaces in the trustzone.
```

## kernel/common/drivers/bus/mhi/diag/Kconfig
```kconfig
# SPDX-License-Identifier: GPL-2.0-only

config HSP_DIAG
	tristate "HSP diag support"
	depends on MHI_BUS && EVENT_TRACING
	help
	  Select this to use HSP diag infrastructure.
```

## kernel/common/drivers/cviplogger/Kconfig
```kconfig
#
# Copyright (C) 2019 Advanced Micro Devices, Inc. All rights reserved.
#

config CVIP_LOGGER
	bool "CVIP Event Logger"
	help
	  This driver provides support to log events of kernel drivers to allow
	  post-mortom debugging. Events are stored in internal ring buffers for
	  each new event log.
```
